## config/boards/shields/test1/Kconfig.defconfig
```kconfig
if SHIELD_TEST1

config ZMK_POINTING
    default y

config ZMK_KEYBOARD_NAME
    default "test1"

endif
```

## config/west.yml
```yaml
manifest:
  defaults:
    revision: v0.2
  remotes:
    - name: zmkfirmware
      url-base: https://github.com/zmkfirmware
    # Additional modules containing boards/shields/custom code can be listed here as well
    # See https://docs.zephyrproject.org/3.2.0/develop/west/manifest.html#projects
    # START #####
    - name: badjeff
      url-base: https://github.com/badjeff
    # END #######
  projects:
    - name: zmk
      remote: zmkfirmware
      import: app/west.yml
    # START #####
    - name: zmk-analog-input-driver
      remote: badjeff
      revision: main
    # END #######

  self:
    path: config
```
